## dts/bindings/sensor/ambiq,nsx-bme688-i2c.yaml
```yaml
# SPDX-License-Identifier: BSD-3-Clause

title: Bosch BME688 using the Ambiq NSX portable sensor core (i2c)

description: |
  Selects the NSX portable BME688 implementation and its temperature, pressure
  and humidity wrapper. This integration-specific compatible deliberately
  avoids claiming nodes handled by Zephyr's upstream Bosch drivers.

compatible: "ambiq,nsx-bme688"

include: [sensor-device.yaml, i2c-device.yaml]
```

## tests/zephyr/testcase.yaml
```yaml
tests:
  nsx.sensors.zephyr:
    tags: [sensor, i2c, spi]
    platform_allow: [native_sim/native/64, qemu_cortex_m3]
    integration_platforms: [native_sim/native/64]
```

## zephyr/Kconfig
```kconfig
# SPDX-License-Identifier: BSD-3-Clause
menuconfig NSX_SENSORS
	bool "NSX portable sensor cores and Zephyr bus adapter"
	help
	  Caller-owned portable cores. No NSX SDK dependency. Individual cores
	  remain usable directly without a Zephyr sensor API wrapper.

if NSX_SENSORS
config NSX_SENSOR_BME688
	bool "BME688 portable core"
	help
	  Requires a complete C library (for example NEWLIB_LIBC or PICOLIBC),
	  or the native host libc. Minimal libc lacks required math facilities.
config NSX_SENSOR_LEDSTICK
	bool "LED Stick portable core"
config NSX_SENSOR_INA228
	bool "INA228 portable core"
	help
	  Requires a complete C library (for example NEWLIB_LIBC or PICOLIBC),
	  or the native host libc. Minimal libc lacks required math facilities.
config NSX_SENSOR_MPU6050
	bool "MPU6050 portable core"
config NSX_SENSOR_MAX86150
	bool "MAX86150 portable core"
config NSX_SENSOR_ICM45605
	bool "ICM-45605 portable core"
	help
	  Requires a complete C library (for example NEWLIB_LIBC or PICOLIBC),
	  or the native host libc. Minimal libc lacks required math facilities.
config NSX_SENSOR_TSL254X
	bool "TSL254x portable core"
config NSX_SENSOR_T5838
	bool "T5838 portable control core"

config NSX_SENSOR_BME688_ZEPHYR
	bool "BME688 Zephyr temperature/pressure/humidity wrapper"
	depends on SENSOR && (I2C || SPI)
	depends on DT_HAS_AMBIQ_NSX_BME688_ENABLED
	select NSX_SENSOR_BME688
	default y
	help
	  Forced mode, core default oversampling/filter, gas heater disabled.
	  Each fetch updates all three channels. No attributes or triggers.
endif
```
